## conf/layer.conf
```bitbake
# We have a conf and classes directory, add to BBPATH
BBPATH .= ":${LAYERDIR}"

# We have recipes-* directories, add to BBFILES
BBFILES += "${LAYERDIR}/recipes-*/*/*.bb \
	${LAYERDIR}/recipes-*/*/*.bbappend"

LAYERSERIES_COMPAT_celestial = "rocko thud warrior"

BBFILE_COLLECTIONS += "celestial"
BBFILE_PATTERN_celestial = "^${LAYERDIR}/"
BBFILE_PRIORITY_celestial = "99"
```
